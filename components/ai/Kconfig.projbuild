## components/ai/Kconfig.projbuild
```kconfig
menu "CatDex AI"

choice CATDEX_CLASSIFIER_BACKEND
    prompt "Classifier backend"
    default CATDEX_CLASSIFIER_BACKEND_MODEL_STUB
    help
        Select which inference backend is used by classifier.c.

    config CATDEX_CLASSIFIER_BACKEND_MOCK
        bool "Mock backend"

    config CATDEX_CLASSIFIER_BACKEND_MODEL_STUB
        bool "Model stub backend"

    config CATDEX_CLASSIFIER_BACKEND_ESPDL
        bool "esp-dl real model (student96_w1_s3_ptq.espdl)"
endchoice

config CATDEX_CLASSIFIER_MODEL_INPUT_WIDTH
    int "Model input width"
    range 48 160
    default 96

config CATDEX_CLASSIFIER_MODEL_INPUT_HEIGHT
    int "Model input height"
    range 48 160
    default 96

endmenu
```

## components/drivers/Kconfig.projbuild
```kconfig
menu "CatDex"

    choice CATDEX_BOARD_PROFILE
        prompt "Board profile"
        default CATDEX_BOARD_PROFILE_ESP32_S3_EYE

        config CATDEX_BOARD_PROFILE_ESP32_S3_EYE
            bool "ESP32-S3-EYE motherboard"
    endchoice

    config CATDEX_ENABLE_INPUT_DEMO
        bool "Enable scripted demo input"
        default y

    config CATDEX_INPUT_ADC_LOG_RAW
        bool "Log raw ADC keypad samples"
        default n

    config CATDEX_INPUT_ADC_TOLERANCE_MV
        int "ADC keypad tolerance in mV"
        range 80 500
        default 220

    config CATDEX_CAMERA_RESET_GPIO
        int "Camera reset GPIO override"
        range -1 48
        default -1

    config CATDEX_CAMERA_PWDN_GPIO
        int "Camera power-down GPIO override"
        range -1 48
        default -1

    config CATDEX_DISPLAY_TEXT_LOG_ONLY
        bool "Use text log display backend only"
        default y

    config CATDEX_DISPLAY_LOG_MIRROR
        bool "Mirror rendered frames to serial logs even when LCD backend is enabled"
        default y

    config CATDEX_DISPLAY_BOOT_TEST
        bool "Run LCD color self-test during boot"
        default y

    config CATDEX_DISPLAY_BOOT_TEST_MS
        int "LCD self-test step duration (ms)"
        range 80 2000
        default 240

    config CATDEX_DISPLAY_BACKLIGHT_ACTIVE_HIGH
        bool "LCD backlight active level is high"
        default y

    config CATDEX_DISPLAY_BACKLIGHT_SWEEP
        bool "Sweep both backlight polarities during boot test"
        default y

    config CATDEX_DISPLAY_SWAP_XY
        bool "Swap LCD X/Y axes"
        default n

    config CATDEX_DISPLAY_MIRROR_X
        bool "Mirror LCD X axis"
        default n

    config CATDEX_DISPLAY_MIRROR_Y
        bool "Mirror LCD Y axis"
        default n

    config CATDEX_DISPLAY_X_GAP
        int "Extra LCD X gap"
        range 0 80
        default 0

    config CATDEX_DISPLAY_Y_GAP
        int "Extra LCD Y gap"
        range 0 80
        default 0

endmenu
```

## sdkconfig.defaults
```kconfig
CONFIG_PARTITION_TABLE_SINGLE_APP=y
CONFIG_PARTITION_TABLE_FILENAME="partitions.csv"
CONFIG_COMPILER_OPTIMIZATION_SIZE=y
CONFIG_ESPTOOLPY_FLASHSIZE_8MB=y
CONFIG_CATDEX_CLASSIFIER_BACKEND_ESPDL=y
CONFIG_CATDEX_CLASSIFIER_MODEL_INPUT_WIDTH=96
CONFIG_CATDEX_CLASSIFIER_MODEL_INPUT_HEIGHT=96

# PSRAM (ESP32-S3-EYE has 8MB OPI PSRAM)
CONFIG_SPIRAM=y
CONFIG_SPIRAM_MODE_OCT=y
CONFIG_SPIRAM_SPEED_80M=y
CONFIG_SPIRAM_BOOT_INIT=y
CONFIG_SPIRAM_USE_MALLOC=y
CONFIG_SPIRAM_MALLOC_ALWAYSINTERNAL=16384
CONFIG_SPIRAM_ALLOW_BSS_SEG_EXTERNAL_MEMORY=y
CONFIG_SPIRAM_TRY_ALLOCATE_WIFI_LWIP=y
```
